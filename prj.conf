## CMakeLists.txt
```
cmake_minimum_required(VERSION 3.20.0)
find_package(Zephyr REQUIRED HINTS $ENV{ZEPHYR_BASE})

project(dbgtest)

target_sources(app PRIVATE src/main.c src/handoff.c)
target_include_directories(app PRIVATE src)
```

## sample.yaml
```
sample:
  name: Multi-domain debugger fixture
  description: Five independent ELF images across CPUAPP and CPUNET or FLPR
tests:
  sample.dbgtest:
    sysbuild: true
    build_only: true
    tags:
      - debug
      - sysbuild
    platform_allow:
      - nrf5340_audio_dk/nrf5340/cpuapp
      - nrf54l15dk/nrf54l15/cpuapp
    integration_platforms:
      - nrf5340_audio_dk/nrf5340/cpuapp
      - nrf54l15dk/nrf54l15/cpuapp
```

## prj.conf
```kconfig
CONFIG_ASSERT=y
CONFIG_NO_OPTIMIZATIONS=y
CONFIG_MAIN_STACK_SIZE=2048
CONFIG_MULTITHREADING=n
CONFIG_SYS_CLOCK_EXISTS=n
CONFIG_SERIAL=n
CONFIG_CONSOLE=n
CONFIG_UART_CONSOLE=n
CONFIG_BOOT_BANNER=n
CONFIG_USE_DT_CODE_PARTITION=y
CONFIG_INIT_ARCH_HW_AT_BOOT=y
```

## src/main.c
```c
#include <zephyr/kernel.h>
#include "image_control.h"

int main(void)
{
	volatile struct debugger_selection *selection = debugger_selection_get();

	if (!debugger_selection_valid(selection)) {
		selection->magic = 0;
		selection->app = 0;
		selection->secondary = 0;
		selection->boots = 0;
		selection->inverse_magic = ~DEBUGGER_SELECTION_MAGIC;
		selection->magic = DEBUGGER_SELECTION_MAGIC;
	}
	selection->boots++;
	if (selection->app == 0) {
		uintptr_t address = DEBUGGER_PARTITION_ADDRESS(DT_NODELABEL(app_a_partition));

		debugger_handoff(address, DT_REG_SIZE(DT_NODELABEL(app_a_partition)));
	} else {
		uintptr_t address = DEBUGGER_PARTITION_ADDRESS(DT_NODELABEL(app_b_partition));

		debugger_handoff(address, DT_REG_SIZE(DT_NODELABEL(app_b_partition)));
	}
}
```

## src/application.c
```c
#include <zephyr/kernel.h>
#include "image_control.h"
#include "workload.h"

int main(void)
{
#if DEBUGGER_IMAGE_ID < 3
	int result = debugger_buttons_init();

	if (result != 0) {
		k_panic();
	}
	debugger_secondary_start();
#endif
	if (debugger_workload_start() != 0) {
		k_panic();
	}
	return 0;
}
```

## src/buttons.c
```c
#include <zephyr/drivers/gpio.h>
#include <zephyr/kernel.h>
#include <zephyr/sys/reboot.h>
#include "image_control.h"

#if defined(CONFIG_SOC_NRF5340_CPUAPP)
#include <nrf53_cpunet_mgmt.h>
#else
#include <hal/nrf_vpr.h>
#endif

struct switch_button {
	struct gpio_dt_spec gpio;
	struct gpio_callback callback;
	struct k_work_delayable debounce;
	bool secondary;
};

static struct switch_button buttons[] = {
	{.gpio = GPIO_DT_SPEC_GET(DT_ALIAS(sw0), gpios), .secondary = false},
	{.gpio = GPIO_DT_SPEC_GET(DT_ALIAS(sw1), gpios), .secondary = true},
};

static void switch_image(struct k_work *work)
{
	struct switch_button *button = CONTAINER_OF(k_work_delayable_from_work(work),
						   struct switch_button, debounce);
	int pressed = gpio_pin_get_dt(&button->gpio);

	if (pressed < 0) {
		k_panic();
	}
	if (pressed == 0) {
		return;
	}
#if defined(CONFIG_SOC_NRF5340_CPUAPP)
	nrf53_cpunet_enable(false);
#else
	nrf_vpr_cpurun_set((NRF_VPR_Type *)DT_REG_ADDR(DT_NODELABEL(cpuflpr_vpr)), false);
#endif
	volatile struct debugger_selection *selection = debugger_selection_get();

	if (button->secondary) {
		selection->secondary ^= 1;
	} else {
		selection->app ^= 1;
	}
	sys_reboot(SYS_REBOOT_WARM);
}

static void button_pressed(const struct device *device, struct gpio_callback *callback,
			   gpio_port_pins_t pins)
{
	ARG_UNUSED(device);
	ARG_UNUSED(pins);
	struct switch_button *button = CONTAINER_OF(callback, struct switch_button, callback);

	if (k_work_reschedule(&button->debounce, K_MSEC(40)) < 0) {
		k_panic();
	}
}

int debugger_buttons_init(void)
{
	for (size_t index = 0; index < ARRAY_SIZE(buttons); index++) {
		struct switch_button *button = &buttons[index];

		if (!gpio_is_ready_dt(&button->gpio)) {
			return -ENODEV;
		}
		k_work_init_delayable(&button->debounce, switch_image);
		int result = gpio_pin_configure_dt(&button->gpio, GPIO_INPUT);

		if (result != 0) {
			return result;
		}
		gpio_init_callback(&button->callback, button_pressed, BIT(button->gpio.pin));
		result = gpio_add_callback(button->gpio.port, &button->callback);
		if (result != 0) {
			return result;
		}
		result = gpio_pin_interrupt_configure_dt(&button->gpio, GPIO_INT_EDGE_TO_ACTIVE);
		if (result != 0) {
			return result;
		}
	}
	return 0;
}
```

## src/handoff.c
```c
#include <zephyr/kernel.h>
#include <cmsis_core.h>
#include "image_control.h"

__attribute__((naked, noreturn)) static void branch_to_image(uint32_t stack, uint32_t entry)
{
	__asm__ volatile(
		"movs r2, #0\n"
		"msr control, r2\n"
		"msr basepri, r2\n"
		"msr msplim, r2\n"
		"msr psplim, r2\n"
		"isb\n"
		"msr msp, r0\n"
		"dsb\n"
		"isb\n"
		"bx r1\n");
}

FUNC_NORETURN void debugger_handoff(uintptr_t address, size_t size)
{
	const uint32_t *vectors = (const uint32_t *)address;
	uint32_t stack = vectors[0];
	uint32_t entry = vectors[1];
	uintptr_t ram_start = DT_REG_ADDR(DT_CHOSEN(zephyr_sram));
	uintptr_t ram_end = ram_start + DT_REG_SIZE(DT_CHOSEN(zephyr_sram));

	if ((stack & 7) != 0 || stack <= ram_start || stack > ram_end ||
	    !(entry & 1) || (entry & ~1u) < address || (entry & ~1u) >= address + size) {
		k_panic();
	}
	__disable_irq();
	SysTick->CTRL = 0;
	SysTick->LOAD = 0;
	SysTick->VAL = 0;
	for (size_t index = 0; index < ARRAY_SIZE(NVIC->ICER); index++) {
		NVIC->ICER[index] = UINT32_MAX;
		NVIC->ICPR[index] = UINT32_MAX;
	}
	SCB->ICSR = SCB_ICSR_PENDSTCLR_Msk | SCB_ICSR_PENDSVCLR_Msk;
	SCB->VTOR = address;
	__DSB();
	__ISB();
	branch_to_image(stack, entry);
}
```

## src/image_control.h
```c
#ifndef DBGTEST_IMAGE_CONTROL_H
#define DBGTEST_IMAGE_CONTROL_H

#include <zephyr/devicetree.h>
#include <zephyr/toolchain.h>
#include <stdbool.h>
#include <stdint.h>
#include <stddef.h>

#define DEBUGGER_SELECTION_MAGIC 0x44424754u
#define DEBUGGER_PARTITION_ADDRESS(node) \
	COND_CODE_1(DT_NODE_HAS_COMPAT(node, zephyr_mapped_partition), \
		    (DT_REG_ADDR(node)), \
		    (DT_REG_ADDR(DT_GPARENT(node)) + DT_REG_ADDR(node)))

struct debugger_selection {
	uint32_t magic;
	uint32_t inverse_magic;
	uint32_t app;
	uint32_t secondary;
	uint32_t boots;
};

static inline volatile struct debugger_selection *debugger_selection_get(void)
{
	return (volatile struct debugger_selection *)DT_REG_ADDR(DT_NODELABEL(debugger_retained));
}

static inline bool debugger_selection_valid(volatile struct debugger_selection *selection)
{
	return selection->magic == DEBUGGER_SELECTION_MAGIC &&
	       selection->inverse_magic == ~DEBUGGER_SELECTION_MAGIC &&
	       selection->app < 2 && selection->secondary < 2;
}

FUNC_NORETURN void debugger_handoff(uintptr_t address, size_t size);
int debugger_buttons_init(void);
void debugger_secondary_start(void);

#endif
```

## src/network_select.c
```c
#include <zephyr/init.h>
#include "image_control.h"

static int network_select(void)
{
#if DEBUGGER_IMAGE_ID == 3
	volatile struct debugger_selection *selection = debugger_selection_get();

	if (debugger_selection_valid(selection) && selection->secondary != 0) {
		uintptr_t address = DEBUGGER_PARTITION_ADDRESS(DT_NODELABEL(app_d_partition));

		debugger_handoff(address, DT_REG_SIZE(DT_NODELABEL(app_d_partition)));
	}
#endif
	return 0;
}

SYS_INIT(network_select, EARLY, 0);
```

## src/secondary.c
```c
#include "image_control.h"

#if defined(CONFIG_SOC_NRF5340_CPUAPP)
#include <nrf53_cpunet_mgmt.h>
#include <hal/nrf_spu.h>
#else
#include <hal/nrf_vpr.h>
#include <hal/nrf_spu.h>
#endif

void debugger_secondary_start(void)
{
#if !defined(CONFIG_SOC_NRF5340_CPUAPP)
	NRF_VPR_Type *vpr = (NRF_VPR_Type *)DT_REG_ADDR(DT_NODELABEL(cpuflpr_vpr));
	volatile struct debugger_selection *selection = debugger_selection_get();
	uintptr_t address;

	if (selection->secondary != 0) {
		address = DEBUGGER_PARTITION_ADDRESS(DT_NODELABEL(app_d_partition));
	} else {
		address = DEBUGGER_PARTITION_ADDRESS(DT_NODELABEL(app_c_partition));
	}
	nrf_spu_periph_perm_secattr_set(NRF_SPU00, nrf_address_slave_get((uint32_t)vpr), true);
	nrf_vpr_initpc_set(vpr, address);
	nrf_vpr_cpurun_set(vpr, true);
#endif
}
```

## src/workload.c
```c
#include <zephyr/kernel.h>
#include <zephyr/sys/util.h>
#include <string.h>
#include "workload.h"

#ifndef DEBUGGER_IMAGE_ID
#define DEBUGGER_IMAGE_ID 1
#endif

const char debugger_image_name[] = "debugger-image-" STRINGIFY(DEBUGGER_IMAGE_ID);
struct debugger_state debugger_globals = {
	.image_name = debugger_image_name,
	.image_id = DEBUGGER_IMAGE_ID,
};
static K_MUTEX_DEFINE(state_lock);
K_MSGQ_DEFINE(samples, sizeof(struct debugger_sample), 4, 4);
static K_SEM_DEFINE(start_gate, 0, 3);

__attribute__((noinline)) int64_t debugger_leaf(struct debugger_sample *sample)
{
	volatile int32_t local_values[8];
	int64_t local_sum = 0;

	for (size_t index = 0; index < ARRAY_SIZE(local_values); index++) {
		local_values[index] = sample->values[index] * DEBUGGER_IMAGE_ID;
		local_sum += local_values[index];
	}
	k_sleep(K_MSEC(20));
	return local_sum;
}

__attribute__((noinline)) int64_t debugger_nested(struct debugger_sample *sample)
{
	struct debugger_sample local_copy = *sample;
	volatile uint32_t local_cookie = 0xd06b0000 | DEBUGGER_IMAGE_ID;
	int64_t result = debugger_leaf(&local_copy);

	return result + (local_cookie & 0xff);
}

static void producer(void *unused1, void *unused2, void *unused3)
{
	ARG_UNUSED(unused1);
	ARG_UNUSED(unused2);
	ARG_UNUSED(unused3);
	uint32_t sequence = 0;

	k_sem_take(&start_gate, K_FOREVER);
	for (;;) {
		struct debugger_sample local_sample = {.sequence = ++sequence};

		memcpy(local_sample.label, "stack-sample", sizeof("stack-sample"));
		for (size_t index = 0; index < ARRAY_SIZE(local_sample.values); index++) {
			local_sample.values[index] = (sequence & 0x7fff) + index;
		}
		k_mutex_lock(&state_lock, K_FOREVER);
		if (k_msgq_put(&samples, &local_sample, K_NO_WAIT) == 0) {
			debugger_globals.produced = sequence;
		}
		k_mutex_unlock(&state_lock);
		k_sleep(K_MSEC(250));
	}
}

static void consumer(void *unused1, void *unused2, void *unused3)
{
	ARG_UNUSED(unused1);
	ARG_UNUSED(unused2);
	ARG_UNUSED(unused3);
	k_sem_take(&start_gate, K_FOREVER);
	for (;;) {
		struct debugger_sample local_sample;

		if (k_msgq_get(&samples, &local_sample, K_FOREVER) == 0) {
			int64_t local_result = debugger_nested(&local_sample);

			k_mutex_lock(&state_lock, K_FOREVER);
			debugger_globals.last_sample = local_sample;
			debugger_globals.checksum = local_result;
			debugger_globals.consumed++;
			k_mutex_unlock(&state_lock);
		}
	}
}

static void observer(void *unused1, void *unused2, void *unused3)
{
	ARG_UNUSED(unused1);
	ARG_UNUSED(unused2);
	ARG_UNUSED(unused3);
	k_sem_take(&start_gate, K_FOREVER);
	for (;;) {
		struct debugger_state local_snapshot;

		k_mutex_lock(&state_lock, K_FOREVER);
		debugger_globals.heartbeat++;
		local_snapshot = debugger_globals;
		k_mutex_unlock(&state_lock);
		__ASSERT(local_snapshot.consumed <= local_snapshot.produced, "queue invariant");
		k_sleep(K_SECONDS(1));
	}
}

K_THREAD_DEFINE(producer_thread, 2048, producer, NULL, NULL, NULL, 5, 0, 0);
K_THREAD_DEFINE(consumer_thread, 2048, consumer, NULL, NULL, NULL, 6, 0, 0);
K_THREAD_DEFINE(observer_thread, 2048, observer, NULL, NULL, NULL, 7, 0, 0);

int debugger_workload_start(void)
{
	int result = k_thread_name_set(producer_thread, "producer");

	if (result == 0) {
		result = k_thread_name_set(consumer_thread, "consumer");
	}
	if (result == 0) {
		result = k_thread_name_set(observer_thread, "observer");
	}
	if (result != 0) {
		return result;
	}
	for (size_t index = 0; index < 3; index++) {
		k_sem_give(&start_gate);
	}
	return 0;
}
```

## src/workload.h
```c
#ifndef DBGTEST_WORKLOAD_H
#define DBGTEST_WORKLOAD_H

#include <stdint.h>

struct debugger_sample {
	uint32_t sequence;
	int32_t values[8];
	char label[16];
};

struct debugger_state {
	const char *image_name;
	uint32_t image_id;
	uint32_t produced;
	uint32_t consumed;
	uint32_t heartbeat;
	int64_t checksum;
	struct debugger_sample last_sample;
};

extern struct debugger_state debugger_globals;
int debugger_workload_start(void);

#endif
```
